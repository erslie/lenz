ENTRY(_start)
SECTIONS {{
    . = {s};
    __kernel_start = .;
    .text : {{
        KEEP(*(.text.boot))
        *(.text .text.*)
        KEEP(*(.text.vectors))
    }}
    . = ALIGN(4096);
    __text_end = .;
    .rodata : {{ *(.rodata .rodata.*) }}
    .eh_frame_hdr : {{ *(.eh_frame_hdr) }}
    .eh_frame : {{ KEEP(*(.eh_frame)) }}
    . = ALIGN(4096);
    __rodata_end = .;
    .data : {{ *(.data .data.*) }}
    . = ALIGN(16);
    __bss_start = .;
    .bss (NOLOAD) : {{ *(.bss .bss.*) *(COMMON) }}
    . = ALIGN(16);
    __bss_end = .;
    . = ALIGN(4096);
    __stack_guard = .;
    . += 4096;
    __stack_bottom = .;
    . += 0x10000;
    __stack_top = .;
    __exc_stack_guard = .;
    . += 4096;
    __exc_stack_bottom = .;
    . += 0x4000;
    __exc_stack_top = .;
    . = ALIGN(4096);
    .lenzsyms : {{ KEEP(*(.lenzsyms)) }}
    . = ALIGN(4096);
    __kernel_end = .;
    /DISCARD/ : {{ *(.comment) *(.note*) }}
}}
